## meta-fsl-arm-extra/conf/machine/aristeus.conf
```bitbake
#@TYPE: Machine
#@NAME: Synexxus Aristeus
#@SOC: i.MX6Q
#@DESCRIPTION: Machine configuration for Synexxus,Inc. Aristeus
#@MAINTAINER: John Reep <jreep@synexxus.com.com>
#
# Note: This is in testing phase only
#
# By default, this machine will build for the standard Quad-Core, 1GB
# option.
#
# To build U-Boot for other CPU or memory combinations, you can set
# the UBOOT_MACHINE variable in your local.conf according to the
# following table:
#
# Processor           Memory    Configuration
# --------------      ------    --------------------
# i.MX6Quad/Dual        1GB     aristeus_config
#
#
#

include conf/machine/include/imx-base.inc
include conf/machine/include/tune-cortexa9.inc

SOC_FAMILY = "mx6:mx6dl:mx6q"

KERNEL_DEVICETREE = "imx6q-aristeus.dtb imx6qdl-aristeus.dtb"

PREFERRED_PROVIDER_u-boot = "u-boot-synexxus"
PREFERRED_PROVIDER_virtual/kernel ?= "linux-synexxus"
PREFERRED_VERSION_linux-synexxus ?= "3.10.17"
#PREFERRED_VERSION_linux-boundary ?= "3.15.4"

# Use SPI NOR U-Boot by default
IMAGE_BOOTLOADER ?= ""

# Ensure boot scripts will be available at rootfs time
do_rootfs[depends] += "u-boot-script-synexxus:do_deploy"

# Boot scripts to install
BOOT_SCRIPTS = "6x_bootscript-${MACHINE}:6x_bootscript"

UBOOT_MACHINE ?= "aristeus_config"

SERIAL_CONSOLE = "115200 ttymxc0"

MACHINE_EXTRA_RRECOMMENDS += ""

MACHINE_FEATURES += " pci"
```
